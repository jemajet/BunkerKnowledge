.ifndef INCLUDED_CYFITTERGNU_INC
.set INCLUDED_CYFITTERGNU_INC, 1
.include "cydevicegnu.inc"
.include "cydevicegnu_trm.inc"

/* DC */
.set DC__0__INTTYPE, CYREG_PICU3_INTTYPE4
.set DC__0__MASK, 0x10
.set DC__0__PC, CYREG_PRT3_PC4
.set DC__0__PORT, 3
.set DC__0__SHIFT, 4
.set DC__AG, CYREG_PRT3_AG
.set DC__AMUX, CYREG_PRT3_AMUX
.set DC__BIE, CYREG_PRT3_BIE
.set DC__BIT_MASK, CYREG_PRT3_BIT_MASK
.set DC__BYP, CYREG_PRT3_BYP
.set DC__CTL, CYREG_PRT3_CTL
.set DC__DM0, CYREG_PRT3_DM0
.set DC__DM1, CYREG_PRT3_DM1
.set DC__DM2, CYREG_PRT3_DM2
.set DC__DR, CYREG_PRT3_DR
.set DC__INP_DIS, CYREG_PRT3_INP_DIS
.set DC__INTTYPE_BASE, CYDEV_PICU_INTTYPE_PICU3_BASE
.set DC__LCD_COM_SEG, CYREG_PRT3_LCD_COM_SEG
.set DC__LCD_EN, CYREG_PRT3_LCD_EN
.set DC__MASK, 0x10
.set DC__PORT, 3
.set DC__PRT, CYREG_PRT3_PRT
.set DC__PRTDSI__CAPS_SEL, CYREG_PRT3_CAPS_SEL
.set DC__PRTDSI__DBL_SYNC_IN, CYREG_PRT3_DBL_SYNC_IN
.set DC__PRTDSI__OE_SEL0, CYREG_PRT3_OE_SEL0
.set DC__PRTDSI__OE_SEL1, CYREG_PRT3_OE_SEL1
.set DC__PRTDSI__OUT_SEL0, CYREG_PRT3_OUT_SEL0
.set DC__PRTDSI__OUT_SEL1, CYREG_PRT3_OUT_SEL1
.set DC__PRTDSI__SYNC_OUT, CYREG_PRT3_SYNC_OUT
.set DC__PS, CYREG_PRT3_PS
.set DC__SHIFT, 4
.set DC__SLW, CYREG_PRT3_SLW

/* RX */
.set RX__0__INTTYPE, CYREG_PICU6_INTTYPE0
.set RX__0__MASK, 0x01
.set RX__0__PC, CYREG_PRT6_PC0
.set RX__0__PORT, 6
.set RX__0__SHIFT, 0
.set RX__AG, CYREG_PRT6_AG
.set RX__AMUX, CYREG_PRT6_AMUX
.set RX__BIE, CYREG_PRT6_BIE
.set RX__BIT_MASK, CYREG_PRT6_BIT_MASK
.set RX__BYP, CYREG_PRT6_BYP
.set RX__CTL, CYREG_PRT6_CTL
.set RX__DM0, CYREG_PRT6_DM0
.set RX__DM1, CYREG_PRT6_DM1
.set RX__DM2, CYREG_PRT6_DM2
.set RX__DR, CYREG_PRT6_DR
.set RX__INP_DIS, CYREG_PRT6_INP_DIS
.set RX__INTTYPE_BASE, CYDEV_PICU_INTTYPE_PICU6_BASE
.set RX__LCD_COM_SEG, CYREG_PRT6_LCD_COM_SEG
.set RX__LCD_EN, CYREG_PRT6_LCD_EN
.set RX__MASK, 0x01
.set RX__PORT, 6
.set RX__PRT, CYREG_PRT6_PRT
.set RX__PRTDSI__CAPS_SEL, CYREG_PRT6_CAPS_SEL
.set RX__PRTDSI__DBL_SYNC_IN, CYREG_PRT6_DBL_SYNC_IN
.set RX__PRTDSI__OE_SEL0, CYREG_PRT6_OE_SEL0
.set RX__PRTDSI__OE_SEL1, CYREG_PRT6_OE_SEL1
.set RX__PRTDSI__OUT_SEL0, CYREG_PRT6_OUT_SEL0
.set RX__PRTDSI__OUT_SEL1, CYREG_PRT6_OUT_SEL1
.set RX__PRTDSI__SYNC_OUT, CYREG_PRT6_SYNC_OUT
.set RX__PS, CYREG_PRT6_PS
.set RX__SHIFT, 0
.set RX__SLW, CYREG_PRT6_SLW

/* SS */
.set SS__0__INTTYPE, CYREG_PICU3_INTTYPE6
.set SS__0__MASK, 0x40
.set SS__0__PC, CYREG_PRT3_PC6
.set SS__0__PORT, 3
.set SS__0__SHIFT, 6
.set SS__AG, CYREG_PRT3_AG
.set SS__AMUX, CYREG_PRT3_AMUX
.set SS__BIE, CYREG_PRT3_BIE
.set SS__BIT_MASK, CYREG_PRT3_BIT_MASK
.set SS__BYP, CYREG_PRT3_BYP
.set SS__CTL, CYREG_PRT3_CTL
.set SS__DM0, CYREG_PRT3_DM0
.set SS__DM1, CYREG_PRT3_DM1
.set SS__DM2, CYREG_PRT3_DM2
.set SS__DR, CYREG_PRT3_DR
.set SS__INP_DIS, CYREG_PRT3_INP_DIS
.set SS__INTTYPE_BASE, CYDEV_PICU_INTTYPE_PICU3_BASE
.set SS__LCD_COM_SEG, CYREG_PRT3_LCD_COM_SEG
.set SS__LCD_EN, CYREG_PRT3_LCD_EN
.set SS__MASK, 0x40
.set SS__PORT, 3
.set SS__PRT, CYREG_PRT3_PRT
.set SS__PRTDSI__CAPS_SEL, CYREG_PRT3_CAPS_SEL
.set SS__PRTDSI__DBL_SYNC_IN, CYREG_PRT3_DBL_SYNC_IN
.set SS__PRTDSI__OE_SEL0, CYREG_PRT3_OE_SEL0
.set SS__PRTDSI__OE_SEL1, CYREG_PRT3_OE_SEL1
.set SS__PRTDSI__OUT_SEL0, CYREG_PRT3_OUT_SEL0
.set SS__PRTDSI__OUT_SEL1, CYREG_PRT3_OUT_SEL1
.set SS__PRTDSI__SYNC_OUT, CYREG_PRT3_SYNC_OUT
.set SS__PS, CYREG_PRT3_PS
.set SS__SHIFT, 6
.set SS__SLW, CYREG_PRT3_SLW

/* TX */
.set TX__0__INTTYPE, CYREG_PICU12_INTTYPE6
.set TX__0__MASK, 0x40
.set TX__0__PC, CYREG_PRT12_PC6
.set TX__0__PORT, 12
.set TX__0__SHIFT, 6
.set TX__AG, CYREG_PRT12_AG
.set TX__BIE, CYREG_PRT12_BIE
.set TX__BIT_MASK, CYREG_PRT12_BIT_MASK
.set TX__BYP, CYREG_PRT12_BYP
.set TX__DM0, CYREG_PRT12_DM0
.set TX__DM1, CYREG_PRT12_DM1
.set TX__DM2, CYREG_PRT12_DM2
.set TX__DR, CYREG_PRT12_DR
.set TX__INP_DIS, CYREG_PRT12_INP_DIS
.set TX__INTTYPE_BASE, CYDEV_PICU_INTTYPE_PICU12_BASE
.set TX__MASK, 0x40
.set TX__PORT, 12
.set TX__PRT, CYREG_PRT12_PRT
.set TX__PRTDSI__DBL_SYNC_IN, CYREG_PRT12_DBL_SYNC_IN
.set TX__PRTDSI__OE_SEL0, CYREG_PRT12_OE_SEL0
.set TX__PRTDSI__OE_SEL1, CYREG_PRT12_OE_SEL1
.set TX__PRTDSI__OUT_SEL0, CYREG_PRT12_OUT_SEL0
.set TX__PRTDSI__OUT_SEL1, CYREG_PRT12_OUT_SEL1
.set TX__PRTDSI__SYNC_OUT, CYREG_PRT12_SYNC_OUT
.set TX__PS, CYREG_PRT12_PS
.set TX__SHIFT, 6
.set TX__SIO_CFG, CYREG_PRT12_SIO_CFG
.set TX__SIO_DIFF, CYREG_PRT12_SIO_DIFF
.set TX__SIO_HYST_EN, CYREG_PRT12_SIO_HYST_EN
.set TX__SIO_REG_HIFREQ, CYREG_PRT12_SIO_REG_HIFREQ
.set TX__SLW, CYREG_PRT12_SLW

/* LED */
.set LED__0__INTTYPE, CYREG_PICU3_INTTYPE1
.set LED__0__MASK, 0x02
.set LED__0__PC, CYREG_PRT3_PC1
.set LED__0__PORT, 3
.set LED__0__SHIFT, 1
.set LED__AG, CYREG_PRT3_AG
.set LED__AMUX, CYREG_PRT3_AMUX
.set LED__BIE, CYREG_PRT3_BIE
.set LED__BIT_MASK, CYREG_PRT3_BIT_MASK
.set LED__BYP, CYREG_PRT3_BYP
.set LED__CTL, CYREG_PRT3_CTL
.set LED__DM0, CYREG_PRT3_DM0
.set LED__DM1, CYREG_PRT3_DM1
.set LED__DM2, CYREG_PRT3_DM2
.set LED__DR, CYREG_PRT3_DR
.set LED__INP_DIS, CYREG_PRT3_INP_DIS
.set LED__INTTYPE_BASE, CYDEV_PICU_INTTYPE_PICU3_BASE
.set LED__LCD_COM_SEG, CYREG_PRT3_LCD_COM_SEG
.set LED__LCD_EN, CYREG_PRT3_LCD_EN
.set LED__MASK, 0x02
.set LED__PORT, 3
.set LED__PRT, CYREG_PRT3_PRT
.set LED__PRTDSI__CAPS_SEL, CYREG_PRT3_CAPS_SEL
.set LED__PRTDSI__DBL_SYNC_IN, CYREG_PRT3_DBL_SYNC_IN
.set LED__PRTDSI__OE_SEL0, CYREG_PRT3_OE_SEL0
.set LED__PRTDSI__OE_SEL1, CYREG_PRT3_OE_SEL1
.set LED__PRTDSI__OUT_SEL0, CYREG_PRT3_OUT_SEL0
.set LED__PRTDSI__OUT_SEL1, CYREG_PRT3_OUT_SEL1
.set LED__PRTDSI__SYNC_OUT, CYREG_PRT3_SYNC_OUT
.set LED__PS, CYREG_PRT3_PS
.set LED__SHIFT, 1
.set LED__SLW, CYREG_PRT3_SLW

/* LED_1 */
.set LED_1__0__INTTYPE, CYREG_PICU6_INTTYPE3
.set LED_1__0__MASK, 0x08
.set LED_1__0__PC, CYREG_PRT6_PC3
.set LED_1__0__PORT, 6
.set LED_1__0__SHIFT, 3
.set LED_1__AG, CYREG_PRT6_AG
.set LED_1__AMUX, CYREG_PRT6_AMUX
.set LED_1__BIE, CYREG_PRT6_BIE
.set LED_1__BIT_MASK, CYREG_PRT6_BIT_MASK
.set LED_1__BYP, CYREG_PRT6_BYP
.set LED_1__CTL, CYREG_PRT6_CTL
.set LED_1__DM0, CYREG_PRT6_DM0
.set LED_1__DM1, CYREG_PRT6_DM1
.set LED_1__DM2, CYREG_PRT6_DM2
.set LED_1__DR, CYREG_PRT6_DR
.set LED_1__INP_DIS, CYREG_PRT6_INP_DIS
.set LED_1__INTTYPE_BASE, CYDEV_PICU_INTTYPE_PICU6_BASE
.set LED_1__LCD_COM_SEG, CYREG_PRT6_LCD_COM_SEG
.set LED_1__LCD_EN, CYREG_PRT6_LCD_EN
.set LED_1__MASK, 0x08
.set LED_1__PORT, 6
.set LED_1__PRT, CYREG_PRT6_PRT
.set LED_1__PRTDSI__CAPS_SEL, CYREG_PRT6_CAPS_SEL
.set LED_1__PRTDSI__DBL_SYNC_IN, CYREG_PRT6_DBL_SYNC_IN
.set LED_1__PRTDSI__OE_SEL0, CYREG_PRT6_OE_SEL0
.set LED_1__PRTDSI__OE_SEL1, CYREG_PRT6_OE_SEL1
.set LED_1__PRTDSI__OUT_SEL0, CYREG_PRT6_OUT_SEL0
.set LED_1__PRTDSI__OUT_SEL1, CYREG_PRT6_OUT_SEL1
.set LED_1__PRTDSI__SYNC_OUT, CYREG_PRT6_SYNC_OUT
.set LED_1__PS, CYREG_PRT6_PS
.set LED_1__SHIFT, 3
.set LED_1__SLW, CYREG_PRT6_SLW

/* MISO */
.set MISO__0__INTTYPE, CYREG_PICU3_INTTYPE0
.set MISO__0__MASK, 0x01
.set MISO__0__PC, CYREG_PRT3_PC0
.set MISO__0__PORT, 3
.set MISO__0__SHIFT, 0
.set MISO__AG, CYREG_PRT3_AG
.set MISO__AMUX, CYREG_PRT3_AMUX
.set MISO__BIE, CYREG_PRT3_BIE
.set MISO__BIT_MASK, CYREG_PRT3_BIT_MASK
.set MISO__BYP, CYREG_PRT3_BYP
.set MISO__CTL, CYREG_PRT3_CTL
.set MISO__DM0, CYREG_PRT3_DM0
.set MISO__DM1, CYREG_PRT3_DM1
.set MISO__DM2, CYREG_PRT3_DM2
.set MISO__DR, CYREG_PRT3_DR
.set MISO__INP_DIS, CYREG_PRT3_INP_DIS
.set MISO__INTTYPE_BASE, CYDEV_PICU_INTTYPE_PICU3_BASE
.set MISO__LCD_COM_SEG, CYREG_PRT3_LCD_COM_SEG
.set MISO__LCD_EN, CYREG_PRT3_LCD_EN
.set MISO__MASK, 0x01
.set MISO__PORT, 3
.set MISO__PRT, CYREG_PRT3_PRT
.set MISO__PRTDSI__CAPS_SEL, CYREG_PRT3_CAPS_SEL
.set MISO__PRTDSI__DBL_SYNC_IN, CYREG_PRT3_DBL_SYNC_IN
.set MISO__PRTDSI__OE_SEL0, CYREG_PRT3_OE_SEL0
.set MISO__PRTDSI__OE_SEL1, CYREG_PRT3_OE_SEL1
.set MISO__PRTDSI__OUT_SEL0, CYREG_PRT3_OUT_SEL0
.set MISO__PRTDSI__OUT_SEL1, CYREG_PRT3_OUT_SEL1
.set MISO__PRTDSI__SYNC_OUT, CYREG_PRT3_SYNC_OUT
.set MISO__PS, CYREG_PRT3_PS
.set MISO__SHIFT, 0
.set MISO__SLW, CYREG_PRT3_SLW

/* MOSI */
.set MOSI__0__INTTYPE, CYREG_PICU3_INTTYPE3
.set MOSI__0__MASK, 0x08
.set MOSI__0__PC, CYREG_PRT3_PC3
.set MOSI__0__PORT, 3
.set MOSI__0__SHIFT, 3
.set MOSI__AG, CYREG_PRT3_AG
.set MOSI__AMUX, CYREG_PRT3_AMUX
.set MOSI__BIE, CYREG_PRT3_BIE
.set MOSI__BIT_MASK, CYREG_PRT3_BIT_MASK
.set MOSI__BYP, CYREG_PRT3_BYP
.set MOSI__CTL, CYREG_PRT3_CTL
.set MOSI__DM0, CYREG_PRT3_DM0
.set MOSI__DM1, CYREG_PRT3_DM1
.set MOSI__DM2, CYREG_PRT3_DM2
.set MOSI__DR, CYREG_PRT3_DR
.set MOSI__INP_DIS, CYREG_PRT3_INP_DIS
.set MOSI__INTTYPE_BASE, CYDEV_PICU_INTTYPE_PICU3_BASE
.set MOSI__LCD_COM_SEG, CYREG_PRT3_LCD_COM_SEG
.set MOSI__LCD_EN, CYREG_PRT3_LCD_EN
.set MOSI__MASK, 0x08
.set MOSI__PORT, 3
.set MOSI__PRT, CYREG_PRT3_PRT
.set MOSI__PRTDSI__CAPS_SEL, CYREG_PRT3_CAPS_SEL
.set MOSI__PRTDSI__DBL_SYNC_IN, CYREG_PRT3_DBL_SYNC_IN
.set MOSI__PRTDSI__OE_SEL0, CYREG_PRT3_OE_SEL0
.set MOSI__PRTDSI__OE_SEL1, CYREG_PRT3_OE_SEL1
.set MOSI__PRTDSI__OUT_SEL0, CYREG_PRT3_OUT_SEL0
.set MOSI__PRTDSI__OUT_SEL1, CYREG_PRT3_OUT_SEL1
.set MOSI__PRTDSI__SYNC_OUT, CYREG_PRT3_SYNC_OUT
.set MOSI__PS, CYREG_PRT3_PS
.set MOSI__SHIFT, 3
.set MOSI__SLW, CYREG_PRT3_SLW

/* SCLK */
.set SCLK__0__INTTYPE, CYREG_PICU3_INTTYPE2
.set SCLK__0__MASK, 0x04
.set SCLK__0__PC, CYREG_PRT3_PC2
.set SCLK__0__PORT, 3
.set SCLK__0__SHIFT, 2
.set SCLK__AG, CYREG_PRT3_AG
.set SCLK__AMUX, CYREG_PRT3_AMUX
.set SCLK__BIE, CYREG_PRT3_BIE
.set SCLK__BIT_MASK, CYREG_PRT3_BIT_MASK
.set SCLK__BYP, CYREG_PRT3_BYP
.set SCLK__CTL, CYREG_PRT3_CTL
.set SCLK__DM0, CYREG_PRT3_DM0
.set SCLK__DM1, CYREG_PRT3_DM1
.set SCLK__DM2, CYREG_PRT3_DM2
.set SCLK__DR, CYREG_PRT3_DR
.set SCLK__INP_DIS, CYREG_PRT3_INP_DIS
.set SCLK__INTTYPE_BASE, CYDEV_PICU_INTTYPE_PICU3_BASE
.set SCLK__LCD_COM_SEG, CYREG_PRT3_LCD_COM_SEG
.set SCLK__LCD_EN, CYREG_PRT3_LCD_EN
.set SCLK__MASK, 0x04
.set SCLK__PORT, 3
.set SCLK__PRT, CYREG_PRT3_PRT
.set SCLK__PRTDSI__CAPS_SEL, CYREG_PRT3_CAPS_SEL
.set SCLK__PRTDSI__DBL_SYNC_IN, CYREG_PRT3_DBL_SYNC_IN
.set SCLK__PRTDSI__OE_SEL0, CYREG_PRT3_OE_SEL0
.set SCLK__PRTDSI__OE_SEL1, CYREG_PRT3_OE_SEL1
.set SCLK__PRTDSI__OUT_SEL0, CYREG_PRT3_OUT_SEL0
.set SCLK__PRTDSI__OUT_SEL1, CYREG_PRT3_OUT_SEL1
.set SCLK__PRTDSI__SYNC_OUT, CYREG_PRT3_SYNC_OUT
.set SCLK__PS, CYREG_PRT3_PS
.set SCLK__SHIFT, 2
.set SCLK__SLW, CYREG_PRT3_SLW

/* UART_BUART */
.set UART_BUART_sRX_RxBitCounter__16BIT_CONTROL_AUX_CTL_REG, CYREG_B1_UDB09_10_ACTL
.set UART_BUART_sRX_RxBitCounter__16BIT_CONTROL_CONTROL_REG, CYREG_B1_UDB09_10_CTL
.set UART_BUART_sRX_RxBitCounter__16BIT_CONTROL_COUNT_REG, CYREG_B1_UDB09_10_CTL
.set UART_BUART_sRX_RxBitCounter__16BIT_COUNT_CONTROL_REG, CYREG_B1_UDB09_10_CTL
.set UART_BUART_sRX_RxBitCounter__16BIT_COUNT_COUNT_REG, CYREG_B1_UDB09_10_CTL
.set UART_BUART_sRX_RxBitCounter__16BIT_MASK_MASK_REG, CYREG_B1_UDB09_10_MSK
.set UART_BUART_sRX_RxBitCounter__16BIT_MASK_PERIOD_REG, CYREG_B1_UDB09_10_MSK
.set UART_BUART_sRX_RxBitCounter__16BIT_PERIOD_MASK_REG, CYREG_B1_UDB09_10_MSK
.set UART_BUART_sRX_RxBitCounter__16BIT_PERIOD_PERIOD_REG, CYREG_B1_UDB09_10_MSK
.set UART_BUART_sRX_RxBitCounter__CONTROL_AUX_CTL_REG, CYREG_B1_UDB09_ACTL
.set UART_BUART_sRX_RxBitCounter__CONTROL_REG, CYREG_B1_UDB09_CTL
.set UART_BUART_sRX_RxBitCounter__CONTROL_ST_REG, CYREG_B1_UDB09_ST_CTL
.set UART_BUART_sRX_RxBitCounter__COUNT_REG, CYREG_B1_UDB09_CTL
.set UART_BUART_sRX_RxBitCounter__COUNT_ST_REG, CYREG_B1_UDB09_ST_CTL
.set UART_BUART_sRX_RxBitCounter__MASK_CTL_AUX_CTL_REG, CYREG_B1_UDB09_MSK_ACTL
.set UART_BUART_sRX_RxBitCounter__PER_CTL_AUX_CTL_REG, CYREG_B1_UDB09_MSK_ACTL
.set UART_BUART_sRX_RxBitCounter__PERIOD_REG, CYREG_B1_UDB09_MSK
.set UART_BUART_sRX_RxBitCounter_ST__16BIT_STATUS_AUX_CTL_REG, CYREG_B1_UDB09_10_ACTL
.set UART_BUART_sRX_RxBitCounter_ST__16BIT_STATUS_REG, CYREG_B1_UDB09_10_ST
.set UART_BUART_sRX_RxBitCounter_ST__MASK_REG, CYREG_B1_UDB09_MSK
.set UART_BUART_sRX_RxBitCounter_ST__MASK_ST_AUX_CTL_REG, CYREG_B1_UDB09_MSK_ACTL
.set UART_BUART_sRX_RxBitCounter_ST__PER_ST_AUX_CTL_REG, CYREG_B1_UDB09_MSK_ACTL
.set UART_BUART_sRX_RxBitCounter_ST__STATUS_AUX_CTL_REG, CYREG_B1_UDB09_ACTL
.set UART_BUART_sRX_RxBitCounter_ST__STATUS_CNT_REG, CYREG_B1_UDB09_ST_CTL
.set UART_BUART_sRX_RxBitCounter_ST__STATUS_CONTROL_REG, CYREG_B1_UDB09_ST_CTL
.set UART_BUART_sRX_RxBitCounter_ST__STATUS_REG, CYREG_B1_UDB09_ST
.set UART_BUART_sRX_RxShifter_u0__16BIT_A0_REG, CYREG_B0_UDB09_10_A0
.set UART_BUART_sRX_RxShifter_u0__16BIT_A1_REG, CYREG_B0_UDB09_10_A1
.set UART_BUART_sRX_RxShifter_u0__16BIT_D0_REG, CYREG_B0_UDB09_10_D0
.set UART_BUART_sRX_RxShifter_u0__16BIT_D1_REG, CYREG_B0_UDB09_10_D1
.set UART_BUART_sRX_RxShifter_u0__16BIT_DP_AUX_CTL_REG, CYREG_B0_UDB09_10_ACTL
.set UART_BUART_sRX_RxShifter_u0__16BIT_F0_REG, CYREG_B0_UDB09_10_F0
.set UART_BUART_sRX_RxShifter_u0__16BIT_F1_REG, CYREG_B0_UDB09_10_F1
.set UART_BUART_sRX_RxShifter_u0__A0_A1_REG, CYREG_B0_UDB09_A0_A1
.set UART_BUART_sRX_RxShifter_u0__A0_REG, CYREG_B0_UDB09_A0
.set UART_BUART_sRX_RxShifter_u0__A1_REG, CYREG_B0_UDB09_A1
.set UART_BUART_sRX_RxShifter_u0__D0_D1_REG, CYREG_B0_UDB09_D0_D1
.set UART_BUART_sRX_RxShifter_u0__D0_REG, CYREG_B0_UDB09_D0
.set UART_BUART_sRX_RxShifter_u0__D1_REG, CYREG_B0_UDB09_D1
.set UART_BUART_sRX_RxShifter_u0__DP_AUX_CTL_REG, CYREG_B0_UDB09_ACTL
.set UART_BUART_sRX_RxShifter_u0__F0_F1_REG, CYREG_B0_UDB09_F0_F1
.set UART_BUART_sRX_RxShifter_u0__F0_REG, CYREG_B0_UDB09_F0
.set UART_BUART_sRX_RxShifter_u0__F1_REG, CYREG_B0_UDB09_F1
.set UART_BUART_sRX_RxSts__16BIT_STATUS_AUX_CTL_REG, CYREG_B0_UDB10_11_ACTL
.set UART_BUART_sRX_RxSts__16BIT_STATUS_REG, CYREG_B0_UDB10_11_ST
.set UART_BUART_sRX_RxSts__3__MASK, 0x08
.set UART_BUART_sRX_RxSts__3__POS, 3
.set UART_BUART_sRX_RxSts__4__MASK, 0x10
.set UART_BUART_sRX_RxSts__4__POS, 4
.set UART_BUART_sRX_RxSts__5__MASK, 0x20
.set UART_BUART_sRX_RxSts__5__POS, 5
.set UART_BUART_sRX_RxSts__MASK, 0x38
.set UART_BUART_sRX_RxSts__MASK_REG, CYREG_B0_UDB10_MSK
.set UART_BUART_sRX_RxSts__STATUS_AUX_CTL_REG, CYREG_B0_UDB10_ACTL
.set UART_BUART_sRX_RxSts__STATUS_REG, CYREG_B0_UDB10_ST
.set UART_BUART_sTX_sCLOCK_TxBitClkGen__16BIT_A0_REG, CYREG_B0_UDB08_09_A0
.set UART_BUART_sTX_sCLOCK_TxBitClkGen__16BIT_A1_REG, CYREG_B0_UDB08_09_A1
.set UART_BUART_sTX_sCLOCK_TxBitClkGen__16BIT_D0_REG, CYREG_B0_UDB08_09_D0
.set UART_BUART_sTX_sCLOCK_TxBitClkGen__16BIT_D1_REG, CYREG_B0_UDB08_09_D1
.set UART_BUART_sTX_sCLOCK_TxBitClkGen__16BIT_DP_AUX_CTL_REG, CYREG_B0_UDB08_09_ACTL
.set UART_BUART_sTX_sCLOCK_TxBitClkGen__16BIT_F0_REG, CYREG_B0_UDB08_09_F0
.set UART_BUART_sTX_sCLOCK_TxBitClkGen__16BIT_F1_REG, CYREG_B0_UDB08_09_F1
.set UART_BUART_sTX_sCLOCK_TxBitClkGen__A0_A1_REG, CYREG_B0_UDB08_A0_A1
.set UART_BUART_sTX_sCLOCK_TxBitClkGen__A0_REG, CYREG_B0_UDB08_A0
.set UART_BUART_sTX_sCLOCK_TxBitClkGen__A1_REG, CYREG_B0_UDB08_A1
.set UART_BUART_sTX_sCLOCK_TxBitClkGen__D0_D1_REG, CYREG_B0_UDB08_D0_D1
.set UART_BUART_sTX_sCLOCK_TxBitClkGen__D0_REG, CYREG_B0_UDB08_D0
.set UART_BUART_sTX_sCLOCK_TxBitClkGen__D1_REG, CYREG_B0_UDB08_D1
.set UART_BUART_sTX_sCLOCK_TxBitClkGen__DP_AUX_CTL_REG, CYREG_B0_UDB08_ACTL
.set UART_BUART_sTX_sCLOCK_TxBitClkGen__F0_F1_REG, CYREG_B0_UDB08_F0_F1
.set UART_BUART_sTX_sCLOCK_TxBitClkGen__F0_REG, CYREG_B0_UDB08_F0
.set UART_BUART_sTX_sCLOCK_TxBitClkGen__F1_REG, CYREG_B0_UDB08_F1
.set UART_BUART_sTX_TxShifter_u0__16BIT_A0_REG, CYREG_B0_UDB11_12_A0
.set UART_BUART_sTX_TxShifter_u0__16BIT_A1_REG, CYREG_B0_UDB11_12_A1
.set UART_BUART_sTX_TxShifter_u0__16BIT_D0_REG, CYREG_B0_UDB11_12_D0
.set UART_BUART_sTX_TxShifter_u0__16BIT_D1_REG, CYREG_B0_UDB11_12_D1
.set UART_BUART_sTX_TxShifter_u0__16BIT_DP_AUX_CTL_REG, CYREG_B0_UDB11_12_ACTL
.set UART_BUART_sTX_TxShifter_u0__16BIT_F0_REG, CYREG_B0_UDB11_12_F0
.set UART_BUART_sTX_TxShifter_u0__16BIT_F1_REG, CYREG_B0_UDB11_12_F1
.set UART_BUART_sTX_TxShifter_u0__A0_A1_REG, CYREG_B0_UDB11_A0_A1
.set UART_BUART_sTX_TxShifter_u0__A0_REG, CYREG_B0_UDB11_A0
.set UART_BUART_sTX_TxShifter_u0__A1_REG, CYREG_B0_UDB11_A1
.set UART_BUART_sTX_TxShifter_u0__D0_D1_REG, CYREG_B0_UDB11_D0_D1
.set UART_BUART_sTX_TxShifter_u0__D0_REG, CYREG_B0_UDB11_D0
.set UART_BUART_sTX_TxShifter_u0__D1_REG, CYREG_B0_UDB11_D1
.set UART_BUART_sTX_TxShifter_u0__DP_AUX_CTL_REG, CYREG_B0_UDB11_ACTL
.set UART_BUART_sTX_TxShifter_u0__F0_F1_REG, CYREG_B0_UDB11_F0_F1
.set UART_BUART_sTX_TxShifter_u0__F0_REG, CYREG_B0_UDB11_F0
.set UART_BUART_sTX_TxShifter_u0__F1_REG, CYREG_B0_UDB11_F1
.set UART_BUART_sTX_TxSts__0__MASK, 0x01
.set UART_BUART_sTX_TxSts__0__POS, 0
.set UART_BUART_sTX_TxSts__1__MASK, 0x02
.set UART_BUART_sTX_TxSts__1__POS, 1
.set UART_BUART_sTX_TxSts__16BIT_STATUS_AUX_CTL_REG, CYREG_B0_UDB11_12_ACTL
.set UART_BUART_sTX_TxSts__16BIT_STATUS_REG, CYREG_B0_UDB11_12_ST
.set UART_BUART_sTX_TxSts__2__MASK, 0x04
.set UART_BUART_sTX_TxSts__2__POS, 2
.set UART_BUART_sTX_TxSts__3__MASK, 0x08
.set UART_BUART_sTX_TxSts__3__POS, 3
.set UART_BUART_sTX_TxSts__MASK, 0x0F
.set UART_BUART_sTX_TxSts__MASK_REG, CYREG_B0_UDB11_MSK
.set UART_BUART_sTX_TxSts__STATUS_AUX_CTL_REG, CYREG_B0_UDB11_ACTL
.set UART_BUART_sTX_TxSts__STATUS_REG, CYREG_B0_UDB11_ST

/* UART_IntClock */
.set UART_IntClock__CFG0, CYREG_CLKDIST_DCFG1_CFG0
.set UART_IntClock__CFG1, CYREG_CLKDIST_DCFG1_CFG1
.set UART_IntClock__CFG2, CYREG_CLKDIST_DCFG1_CFG2
.set UART_IntClock__CFG2_SRC_SEL_MASK, 0x07
.set UART_IntClock__INDEX, 0x01
.set UART_IntClock__PM_ACT_CFG, CYREG_PM_ACT_CFG2
.set UART_IntClock__PM_ACT_MSK, 0x02
.set UART_IntClock__PM_STBY_CFG, CYREG_PM_STBY_CFG2
.set UART_IntClock__PM_STBY_MSK, 0x02

/* RESET */
.set RESET__0__INTTYPE, CYREG_PICU3_INTTYPE5
.set RESET__0__MASK, 0x20
.set RESET__0__PC, CYREG_PRT3_PC5
.set RESET__0__PORT, 3
.set RESET__0__SHIFT, 5
.set RESET__AG, CYREG_PRT3_AG
.set RESET__AMUX, CYREG_PRT3_AMUX
.set RESET__BIE, CYREG_PRT3_BIE
.set RESET__BIT_MASK, CYREG_PRT3_BIT_MASK
.set RESET__BYP, CYREG_PRT3_BYP
.set RESET__CTL, CYREG_PRT3_CTL
.set RESET__DM0, CYREG_PRT3_DM0
.set RESET__DM1, CYREG_PRT3_DM1
.set RESET__DM2, CYREG_PRT3_DM2
.set RESET__DR, CYREG_PRT3_DR
.set RESET__INP_DIS, CYREG_PRT3_INP_DIS
.set RESET__INTTYPE_BASE, CYDEV_PICU_INTTYPE_PICU3_BASE
.set RESET__LCD_COM_SEG, CYREG_PRT3_LCD_COM_SEG
.set RESET__LCD_EN, CYREG_PRT3_LCD_EN
.set RESET__MASK, 0x20
.set RESET__PORT, 3
.set RESET__PRT, CYREG_PRT3_PRT
.set RESET__PRTDSI__CAPS_SEL, CYREG_PRT3_CAPS_SEL
.set RESET__PRTDSI__DBL_SYNC_IN, CYREG_PRT3_DBL_SYNC_IN
.set RESET__PRTDSI__OE_SEL0, CYREG_PRT3_OE_SEL0
.set RESET__PRTDSI__OE_SEL1, CYREG_PRT3_OE_SEL1
.set RESET__PRTDSI__OUT_SEL0, CYREG_PRT3_OUT_SEL0
.set RESET__PRTDSI__OUT_SEL1, CYREG_PRT3_OUT_SEL1
.set RESET__PRTDSI__SYNC_OUT, CYREG_PRT3_SYNC_OUT
.set RESET__PS, CYREG_PRT3_PS
.set RESET__SHIFT, 5
.set RESET__SLW, CYREG_PRT3_SLW

/* SPIM_1_BSPIM */
.set SPIM_1_BSPIM_BitCounter__16BIT_CONTROL_AUX_CTL_REG, CYREG_B1_UDB07_08_ACTL
.set SPIM_1_BSPIM_BitCounter__16BIT_CONTROL_CONTROL_REG, CYREG_B1_UDB07_08_CTL
.set SPIM_1_BSPIM_BitCounter__16BIT_CONTROL_COUNT_REG, CYREG_B1_UDB07_08_CTL
.set SPIM_1_BSPIM_BitCounter__16BIT_COUNT_CONTROL_REG, CYREG_B1_UDB07_08_CTL
.set SPIM_1_BSPIM_BitCounter__16BIT_COUNT_COUNT_REG, CYREG_B1_UDB07_08_CTL
.set SPIM_1_BSPIM_BitCounter__16BIT_MASK_MASK_REG, CYREG_B1_UDB07_08_MSK
.set SPIM_1_BSPIM_BitCounter__16BIT_MASK_PERIOD_REG, CYREG_B1_UDB07_08_MSK
.set SPIM_1_BSPIM_BitCounter__16BIT_PERIOD_MASK_REG, CYREG_B1_UDB07_08_MSK
.set SPIM_1_BSPIM_BitCounter__16BIT_PERIOD_PERIOD_REG, CYREG_B1_UDB07_08_MSK
.set SPIM_1_BSPIM_BitCounter__CONTROL_AUX_CTL_REG, CYREG_B1_UDB07_ACTL
.set SPIM_1_BSPIM_BitCounter__CONTROL_REG, CYREG_B1_UDB07_CTL
.set SPIM_1_BSPIM_BitCounter__CONTROL_ST_REG, CYREG_B1_UDB07_ST_CTL
.set SPIM_1_BSPIM_BitCounter__COUNT_REG, CYREG_B1_UDB07_CTL
.set SPIM_1_BSPIM_BitCounter__COUNT_ST_REG, CYREG_B1_UDB07_ST_CTL
.set SPIM_1_BSPIM_BitCounter__MASK_CTL_AUX_CTL_REG, CYREG_B1_UDB07_MSK_ACTL
.set SPIM_1_BSPIM_BitCounter__PER_CTL_AUX_CTL_REG, CYREG_B1_UDB07_MSK_ACTL
.set SPIM_1_BSPIM_BitCounter__PERIOD_REG, CYREG_B1_UDB07_MSK
.set SPIM_1_BSPIM_BitCounter_ST__16BIT_STATUS_AUX_CTL_REG, CYREG_B1_UDB07_08_ACTL
.set SPIM_1_BSPIM_BitCounter_ST__16BIT_STATUS_REG, CYREG_B1_UDB07_08_ST
.set SPIM_1_BSPIM_BitCounter_ST__MASK_REG, CYREG_B1_UDB07_MSK
.set SPIM_1_BSPIM_BitCounter_ST__MASK_ST_AUX_CTL_REG, CYREG_B1_UDB07_MSK_ACTL
.set SPIM_1_BSPIM_BitCounter_ST__PER_ST_AUX_CTL_REG, CYREG_B1_UDB07_MSK_ACTL
.set SPIM_1_BSPIM_BitCounter_ST__STATUS_AUX_CTL_REG, CYREG_B1_UDB07_ACTL
.set SPIM_1_BSPIM_BitCounter_ST__STATUS_CNT_REG, CYREG_B1_UDB07_ST_CTL
.set SPIM_1_BSPIM_BitCounter_ST__STATUS_CONTROL_REG, CYREG_B1_UDB07_ST_CTL
.set SPIM_1_BSPIM_BitCounter_ST__STATUS_REG, CYREG_B1_UDB07_ST
.set SPIM_1_BSPIM_RxStsReg__16BIT_STATUS_AUX_CTL_REG, CYREG_B1_UDB08_09_ACTL
.set SPIM_1_BSPIM_RxStsReg__16BIT_STATUS_REG, CYREG_B1_UDB08_09_ST
.set SPIM_1_BSPIM_RxStsReg__4__MASK, 0x10
.set SPIM_1_BSPIM_RxStsReg__4__POS, 4
.set SPIM_1_BSPIM_RxStsReg__5__MASK, 0x20
.set SPIM_1_BSPIM_RxStsReg__5__POS, 5
.set SPIM_1_BSPIM_RxStsReg__6__MASK, 0x40
.set SPIM_1_BSPIM_RxStsReg__6__POS, 6
.set SPIM_1_BSPIM_RxStsReg__MASK, 0x70
.set SPIM_1_BSPIM_RxStsReg__MASK_REG, CYREG_B1_UDB08_MSK
.set SPIM_1_BSPIM_RxStsReg__STATUS_AUX_CTL_REG, CYREG_B1_UDB08_ACTL
.set SPIM_1_BSPIM_RxStsReg__STATUS_REG, CYREG_B1_UDB08_ST
.set SPIM_1_BSPIM_sR8_Dp_u0__16BIT_A0_REG, CYREG_B1_UDB05_06_A0
.set SPIM_1_BSPIM_sR8_Dp_u0__16BIT_A1_REG, CYREG_B1_UDB05_06_A1
.set SPIM_1_BSPIM_sR8_Dp_u0__16BIT_D0_REG, CYREG_B1_UDB05_06_D0
.set SPIM_1_BSPIM_sR8_Dp_u0__16BIT_D1_REG, CYREG_B1_UDB05_06_D1
.set SPIM_1_BSPIM_sR8_Dp_u0__16BIT_DP_AUX_CTL_REG, CYREG_B1_UDB05_06_ACTL
.set SPIM_1_BSPIM_sR8_Dp_u0__16BIT_F0_REG, CYREG_B1_UDB05_06_F0
.set SPIM_1_BSPIM_sR8_Dp_u0__16BIT_F1_REG, CYREG_B1_UDB05_06_F1
.set SPIM_1_BSPIM_sR8_Dp_u0__A0_A1_REG, CYREG_B1_UDB05_A0_A1
.set SPIM_1_BSPIM_sR8_Dp_u0__A0_REG, CYREG_B1_UDB05_A0
.set SPIM_1_BSPIM_sR8_Dp_u0__A1_REG, CYREG_B1_UDB05_A1
.set SPIM_1_BSPIM_sR8_Dp_u0__D0_D1_REG, CYREG_B1_UDB05_D0_D1
.set SPIM_1_BSPIM_sR8_Dp_u0__D0_REG, CYREG_B1_UDB05_D0
.set SPIM_1_BSPIM_sR8_Dp_u0__D1_REG, CYREG_B1_UDB05_D1
.set SPIM_1_BSPIM_sR8_Dp_u0__DP_AUX_CTL_REG, CYREG_B1_UDB05_ACTL
.set SPIM_1_BSPIM_sR8_Dp_u0__F0_F1_REG, CYREG_B1_UDB05_F0_F1
.set SPIM_1_BSPIM_sR8_Dp_u0__F0_REG, CYREG_B1_UDB05_F0
.set SPIM_1_BSPIM_sR8_Dp_u0__F1_REG, CYREG_B1_UDB05_F1
.set SPIM_1_BSPIM_TxStsReg__0__MASK, 0x01
.set SPIM_1_BSPIM_TxStsReg__0__POS, 0
.set SPIM_1_BSPIM_TxStsReg__1__MASK, 0x02
.set SPIM_1_BSPIM_TxStsReg__1__POS, 1
.set SPIM_1_BSPIM_TxStsReg__16BIT_STATUS_AUX_CTL_REG, CYREG_B1_UDB05_06_ACTL
.set SPIM_1_BSPIM_TxStsReg__16BIT_STATUS_REG, CYREG_B1_UDB05_06_ST
.set SPIM_1_BSPIM_TxStsReg__2__MASK, 0x04
.set SPIM_1_BSPIM_TxStsReg__2__POS, 2
.set SPIM_1_BSPIM_TxStsReg__3__MASK, 0x08
.set SPIM_1_BSPIM_TxStsReg__3__POS, 3
.set SPIM_1_BSPIM_TxStsReg__4__MASK, 0x10
.set SPIM_1_BSPIM_TxStsReg__4__POS, 4
.set SPIM_1_BSPIM_TxStsReg__MASK, 0x1F
.set SPIM_1_BSPIM_TxStsReg__MASK_REG, CYREG_B1_UDB05_MSK
.set SPIM_1_BSPIM_TxStsReg__STATUS_AUX_CTL_REG, CYREG_B1_UDB05_ACTL
.set SPIM_1_BSPIM_TxStsReg__STATUS_REG, CYREG_B1_UDB05_ST

/* SPIM_1_IntClock */
.set SPIM_1_IntClock__CFG0, CYREG_CLKDIST_DCFG0_CFG0
.set SPIM_1_IntClock__CFG1, CYREG_CLKDIST_DCFG0_CFG1
.set SPIM_1_IntClock__CFG2, CYREG_CLKDIST_DCFG0_CFG2
.set SPIM_1_IntClock__CFG2_SRC_SEL_MASK, 0x07
.set SPIM_1_IntClock__INDEX, 0x00
.set SPIM_1_IntClock__PM_ACT_CFG, CYREG_PM_ACT_CFG2
.set SPIM_1_IntClock__PM_ACT_MSK, 0x01
.set SPIM_1_IntClock__PM_STBY_CFG, CYREG_PM_STBY_CFG2
.set SPIM_1_IntClock__PM_STBY_MSK, 0x01

/* rx_int */
.set rx_int__INTC_CLR_EN_REG, CYREG_NVIC_CLRENA0
.set rx_int__INTC_CLR_PD_REG, CYREG_NVIC_CLRPEND0
.set rx_int__INTC_MASK, 0x01
.set rx_int__INTC_NUMBER, 0
.set rx_int__INTC_PRIOR_NUM, 7
.set rx_int__INTC_PRIOR_REG, CYREG_NVIC_PRI_0
.set rx_int__INTC_SET_EN_REG, CYREG_NVIC_SETENA0
.set rx_int__INTC_SET_PD_REG, CYREG_NVIC_SETPEND0

/* tx_int */
.set tx_int__INTC_CLR_EN_REG, CYREG_NVIC_CLRENA0
.set tx_int__INTC_CLR_PD_REG, CYREG_NVIC_CLRPEND0
.set tx_int__INTC_MASK, 0x02
.set tx_int__INTC_NUMBER, 1
.set tx_int__INTC_PRIOR_NUM, 7
.set tx_int__INTC_PRIOR_REG, CYREG_NVIC_PRI_1
.set tx_int__INTC_SET_EN_REG, CYREG_NVIC_SETENA0
.set tx_int__INTC_SET_PD_REG, CYREG_NVIC_SETPEND0

/* Miscellaneous */
.set BCLK__BUS_CLK__HZ, 24000000
.set BCLK__BUS_CLK__KHZ, 24000
.set BCLK__BUS_CLK__MHZ, 24
.set CYDEV_CHIP_DIE_LEOPARD, 1
.set CYDEV_CHIP_DIE_PANTHER, 19
.set CYDEV_CHIP_DIE_PSOC4A, 11
.set CYDEV_CHIP_DIE_PSOC5LP, 18
.set CYDEV_CHIP_DIE_TMA4, 2
.set CYDEV_CHIP_DIE_UNKNOWN, 0
.set CYDEV_CHIP_FAMILY_PSOC3, 1
.set CYDEV_CHIP_FAMILY_PSOC4, 2
.set CYDEV_CHIP_FAMILY_PSOC5, 3
.set CYDEV_CHIP_FAMILY_UNKNOWN, 0
.set CYDEV_CHIP_FAMILY_USED, CYDEV_CHIP_FAMILY_PSOC5
.set CYDEV_CHIP_JTAG_ID, 0x2E123069
.set CYDEV_CHIP_MEMBER_3A, 1
.set CYDEV_CHIP_MEMBER_4A, 11
.set CYDEV_CHIP_MEMBER_4C, 16
.set CYDEV_CHIP_MEMBER_4D, 7
.set CYDEV_CHIP_MEMBER_4E, 4
.set CYDEV_CHIP_MEMBER_4F, 12
.set CYDEV_CHIP_MEMBER_4G, 2
.set CYDEV_CHIP_MEMBER_4H, 10
.set CYDEV_CHIP_MEMBER_4I, 15
.set CYDEV_CHIP_MEMBER_4J, 8
.set CYDEV_CHIP_MEMBER_4K, 9
.set CYDEV_CHIP_MEMBER_4L, 14
.set CYDEV_CHIP_MEMBER_4M, 13
.set CYDEV_CHIP_MEMBER_4N, 6
.set CYDEV_CHIP_MEMBER_4O, 5
.set CYDEV_CHIP_MEMBER_4U, 3
.set CYDEV_CHIP_MEMBER_5A, 18
.set CYDEV_CHIP_MEMBER_5B, 17
.set CYDEV_CHIP_MEMBER_UNKNOWN, 0
.set CYDEV_CHIP_MEMBER_USED, CYDEV_CHIP_MEMBER_5B
.set CYDEV_CHIP_DIE_EXPECT, CYDEV_CHIP_MEMBER_USED
.set CYDEV_CHIP_DIE_ACTUAL, CYDEV_CHIP_DIE_EXPECT
.set CYDEV_CHIP_REV_LEOPARD_ES1, 0
.set CYDEV_CHIP_REV_LEOPARD_ES2, 1
.set CYDEV_CHIP_REV_LEOPARD_ES3, 3
.set CYDEV_CHIP_REV_LEOPARD_PRODUCTION, 3
.set CYDEV_CHIP_REV_PANTHER_ES0, 0
.set CYDEV_CHIP_REV_PANTHER_ES1, 1
.set CYDEV_CHIP_REV_PANTHER_PRODUCTION, 1
.set CYDEV_CHIP_REV_PSOC4A_ES0, 17
.set CYDEV_CHIP_REV_PSOC4A_PRODUCTION, 17
.set CYDEV_CHIP_REV_PSOC5LP_ES0, 0
.set CYDEV_CHIP_REV_PSOC5LP_PRODUCTION, 0
.set CYDEV_CHIP_REV_TMA4_ES, 17
.set CYDEV_CHIP_REV_TMA4_ES2, 33
.set CYDEV_CHIP_REV_TMA4_PRODUCTION, 17
.set CYDEV_CHIP_REVISION_3A_ES1, 0
.set CYDEV_CHIP_REVISION_3A_ES2, 1
.set CYDEV_CHIP_REVISION_3A_ES3, 3
.set CYDEV_CHIP_REVISION_3A_PRODUCTION, 3
.set CYDEV_CHIP_REVISION_4A_ES0, 17
.set CYDEV_CHIP_REVISION_4A_PRODUCTION, 17
.set CYDEV_CHIP_REVISION_4C_PRODUCTION, 0
.set CYDEV_CHIP_REVISION_4D_PRODUCTION, 0
.set CYDEV_CHIP_REVISION_4E_PRODUCTION, 0
.set CYDEV_CHIP_REVISION_4F_PRODUCTION, 0
.set CYDEV_CHIP_REVISION_4F_PRODUCTION_256DMA, 0
.set CYDEV_CHIP_REVISION_4F_PRODUCTION_256K, 0
.set CYDEV_CHIP_REVISION_4G_ES, 17
.set CYDEV_CHIP_REVISION_4G_ES2, 33
.set CYDEV_CHIP_REVISION_4G_PRODUCTION, 17
.set CYDEV_CHIP_REVISION_4H_PRODUCTION, 0
.set CYDEV_CHIP_REVISION_4I_PRODUCTION, 0
.set CYDEV_CHIP_REVISION_4J_PRODUCTION, 0
.set CYDEV_CHIP_REVISION_4K_PRODUCTION, 0
.set CYDEV_CHIP_REVISION_4L_PRODUCTION, 0
.set CYDEV_CHIP_REVISION_4M_PRODUCTION, 0
.set CYDEV_CHIP_REVISION_4N_PRODUCTION, 0
.set CYDEV_CHIP_REVISION_4O_PRODUCTION, 0
.set CYDEV_CHIP_REVISION_4U_PRODUCTION, 0
.set CYDEV_CHIP_REVISION_5A_ES0, 0
.set CYDEV_CHIP_REVISION_5A_ES1, 1
.set CYDEV_CHIP_REVISION_5A_PRODUCTION, 1
.set CYDEV_CHIP_REVISION_5B_ES0, 0
.set CYDEV_CHIP_REVISION_5B_PRODUCTION, 0
.set CYDEV_CHIP_REVISION_USED, CYDEV_CHIP_REVISION_5B_PRODUCTION
.set CYDEV_CHIP_REV_EXPECT, CYDEV_CHIP_REVISION_USED
.set CYDEV_CONFIG_FASTBOOT_ENABLED, 1
.set CYDEV_CONFIG_UNUSED_IO_AllowButWarn, 0
.set CYDEV_CONFIG_UNUSED_IO, CYDEV_CONFIG_UNUSED_IO_AllowButWarn
.set CYDEV_CONFIG_UNUSED_IO_AllowWithInfo, 1
.set CYDEV_CONFIG_UNUSED_IO_Disallowed, 2
.set CYDEV_CONFIGURATION_COMPRESSED, 1
.set CYDEV_CONFIGURATION_DMA, 0
.set CYDEV_CONFIGURATION_ECC, 1
.set CYDEV_CONFIGURATION_IMOENABLED, CYDEV_CONFIG_FASTBOOT_ENABLED
.set CYDEV_CONFIGURATION_MODE_COMPRESSED, 0
.set CYDEV_CONFIGURATION_MODE, CYDEV_CONFIGURATION_MODE_COMPRESSED
.set CYDEV_CONFIGURATION_MODE_DMA, 2
.set CYDEV_CONFIGURATION_MODE_UNCOMPRESSED, 1
.set CYDEV_DEBUG_ENABLE_MASK, 0x20
.set CYDEV_DEBUG_ENABLE_REGISTER, CYREG_MLOGIC_DEBUG
.set CYDEV_DEBUGGING_DPS_Disable, 3
.set CYDEV_DEBUGGING_DPS_JTAG_4, 1
.set CYDEV_DEBUGGING_DPS_JTAG_5, 0
.set CYDEV_DEBUGGING_DPS_SWD, 2
.set CYDEV_DEBUGGING_DPS_SWD_SWV, 6
.set CYDEV_DEBUGGING_DPS, CYDEV_DEBUGGING_DPS_SWD_SWV
.set CYDEV_DEBUGGING_ENABLE, 1
.set CYDEV_DEBUGGING_XRES, 0
.set CYDEV_DMA_CHANNELS_AVAILABLE, 24
.set CYDEV_ECC_ENABLE, 0
.set CYDEV_HEAP_SIZE, 0x1000
.set CYDEV_INSTRUCT_CACHE_ENABLED, 1
.set CYDEV_INTR_RISING, 0x00000000
.set CYDEV_IS_EXPORTING_CODE, 0
.set CYDEV_IS_IMPORTING_CODE, 0
.set CYDEV_PROJ_TYPE, 0
.set CYDEV_PROJ_TYPE_BOOTLOADER, 1
.set CYDEV_PROJ_TYPE_LAUNCHER, 5
.set CYDEV_PROJ_TYPE_LOADABLE, 2
.set CYDEV_PROJ_TYPE_LOADABLEANDBOOTLOADER, 4
.set CYDEV_PROJ_TYPE_MULTIAPPBOOTLOADER, 3
.set CYDEV_PROJ_TYPE_STANDARD, 0
.set CYDEV_PROTECTION_ENABLE, 0
.set CYDEV_STACK_SIZE, 0x4000
.set CYDEV_USE_BUNDLED_CMSIS, 1
.set CYDEV_VARIABLE_VDDA, 0
.set CYDEV_VDDA_MV, 5000
.set CYDEV_VDDD_MV, 5000
.set CYDEV_VDDIO0_MV, 5000
.set CYDEV_VDDIO1_MV, 5000
.set CYDEV_VDDIO2_MV, 5000
.set CYDEV_VDDIO3_MV, 5000
.set CYDEV_VIO0_MV, 5000
.set CYDEV_VIO1_MV, 5000
.set CYDEV_VIO2_MV, 5000
.set CYDEV_VIO3_MV, 5000
.set CYIPBLOCK_ARM_CM3_VERSION, 0
.set CYIPBLOCK_P3_ANAIF_VERSION, 0
.set CYIPBLOCK_P3_CAN_VERSION, 0
.set CYIPBLOCK_P3_CAPSENSE_VERSION, 0
.set CYIPBLOCK_P3_COMP_VERSION, 0
.set CYIPBLOCK_P3_DECIMATOR_VERSION, 0
.set CYIPBLOCK_P3_DFB_VERSION, 0
.set CYIPBLOCK_P3_DMA_VERSION, 0
.set CYIPBLOCK_P3_DRQ_VERSION, 0
.set CYIPBLOCK_P3_DSM_VERSION, 0
.set CYIPBLOCK_P3_EMIF_VERSION, 0
.set CYIPBLOCK_P3_I2C_VERSION, 0
.set CYIPBLOCK_P3_LCD_VERSION, 0
.set CYIPBLOCK_P3_LPF_VERSION, 0
.set CYIPBLOCK_P3_OPAMP_VERSION, 0
.set CYIPBLOCK_P3_PM_VERSION, 0
.set CYIPBLOCK_P3_SCCT_VERSION, 0
.set CYIPBLOCK_P3_TIMER_VERSION, 0
.set CYIPBLOCK_P3_USB_VERSION, 0
.set CYIPBLOCK_P3_VIDAC_VERSION, 0
.set CYIPBLOCK_P3_VREF_VERSION, 0
.set CYIPBLOCK_S8_GPIO_VERSION, 0
.set CYIPBLOCK_S8_IRQ_VERSION, 0
.set CYIPBLOCK_S8_SAR_VERSION, 0
.set CYIPBLOCK_S8_SIO_VERSION, 0
.set CYIPBLOCK_S8_UDB_VERSION, 0
.set DMA_CHANNELS_USED__MASK0, 0x00000000
.set CYDEV_BOOTLOADER_ENABLE, 0
.endif
